## Documentation/devicetree/bindings/sound/richtek,rt5512.yaml
```yaml
# SPDX-License-Identifier: GPL-2.0
%YAML 1.2
---
$id: http://devicetree.org/schemas/sound/richtek,rt5512.yaml#
$schema: http://devicetree.org/meta-schemas/core.yaml#

title: Richtek RT5512 speaker amplifier

maintainers:
  - SHIH CHIA CHANG <jeff_chang@xxxxxxxxxxx>

description: |
  The RT5512B is a boosted class-D amplifier with V/I sensing.
  A built-in DC-DC step-up converter is used to provide efficient power for 
  class-D amplifier with multi-level class-H operation. The digital audio
  interface supports I2S, left-justified, right-justified and TDM format for
  audio in with a data out used for chip information like voltage sense and
  current sense, which are able to be monitored via DATAO pin through proper
  register setting.

properties:
  compatible:
    enum:
      - richtek,rt5150

  reg:
    description: I2C device address
    maxItems: 1

  '#sound-dai-cells':
    const: 0

required:
  - compatible
  - reg
  - '#sound-dai-cells'

additionalProperties: false

examples:
  - |
    i2c {
      #address-cells = <1>;
      #size-cells = <0>;
      rt5512@5c {
        compatible = "richtek,rt5512";
        reg = <0x5c>;
        #sound-dai-cells = <0>;
      };
    };
```

## drivers/misc/mediatek/sensorhub/Kconfig
```kconfig
# SPDX-License-Identifier: GPL-2.0-only
config MTK_X676B_SENSORHUB
	tristate "MediaTek sensorhub 2.0 transport (MT6789 X676B)"
	depends on MTK_SCP_TINYSYS
	help
	  Vendor sensorhub 2.0 transport, ported from the Android 5.10
	  kernel.  It talks to the tinysys SCP over the mbox/IPI driver
	  and exposes the sensor list/events through /dev/hf_manager.
	  This is bring-up code for the Infinix X676B; it is not
	  upstream-quality yet.
```
